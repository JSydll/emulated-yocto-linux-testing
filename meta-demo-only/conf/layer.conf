## meta-demo-only/conf/layer.conf
```bitbake
BBPATH .= ":${LAYERDIR}"
BBFILES += "${LAYERDIR}/recipes-*/*/*.bb \
            ${LAYERDIR}/recipes-*/*/*.bbappend"

BBFILE_COLLECTIONS += "meta-demo-only"
BBFILE_PATTERN_meta-demo-only = "^${LAYERDIR}/"
BBFILE_PRIORITY_meta-demo-only = "15"

LAYERDEPENDS_meta-demo-only = "core"
LAYERSERIES_COMPAT_meta-demo-only = "styhead scarthgap walnascar"
```

## meta-product/wic/efi-system-partition-image.wks
```
# TODO

bootloader --ptable gpt

part --ondisk vda --fstype=vfat --label ESP --part-type=C12A7328-F81F-11D2-BA4B-00A0C93EC93B --fixed-size 64M --align 1024
```

## src/meta-product/conf/layer.conf
```bitbake
BBPATH .= ":${LAYERDIR}"
BBFILES += "${LAYERDIR}/recipes-*/*/*.bb \
            ${LAYERDIR}/recipes-*/*/*.bbappend"

BBFILE_COLLECTIONS += "meta-product"
BBFILE_PATTERN_meta-product = "^${LAYERDIR}/"
BBFILE_PRIORITY_meta-product = "6"

LAYERDEPENDS_meta-product = "core"
LAYERSERIES_COMPAT_meta-product = "styhead scarthgap walnascar"
```

## src/meta-product/conf/machine/virt-aarch64.conf
```bitbake
# Custom virtual (QEMU) machine aiming for a close match of the target hardware
# 
# Heavily based on poky's qemuarm64 machine but with adjustments for 
# - runqemu configuration support
require conf/machine/include/arm/armv8a/tune-cortexa72.inc
require conf/machine/include/qemu.inc

# General
# ----
MACHINEOVERRIDES =. "qemuarm64:"

KERNEL_IMAGETYPE = "Image"

PREFERRED_PROVIDER_virtual/bootloader ?= "u-boot"
UBOOT_MACHINE = "qemu_arm64_defconfig"
KMACHINE:virt-aarch64 = "qemuarm64"

SERIAL_CONSOLES = "115200;ttyAMA0 115200;hvc0"

# QEMU config
# ----
QB_SYSTEM_NAME = "qemu-system-aarch64"
QB_MACHINE = "-machine virt"
QB_CPU = "-cpu cortex-a72"
QB_MEM = "-m 4G"
QB_SMP = "-smp 4"
QB_CPU_KVM = "-cpu host -machine gic-version=3"
QB_TAP_OPT = "-netdev tap,id=net0,ifname=@TAP@,script=no,downscript=no"
QB_NETWORK_DEVICE = "-device virtio-net-pci,netdev=net0,mac=@MAC@"
QB_SERIAL_OPT = "-device virtio-serial-pci -chardev null,id=virtcon -device virtconsole,chardev=virtcon"
QB_TCPSERIAL_OPT = "-device virtio-serial-pci -chardev socket,id=virtcon,port=@PORT@,host=127.0.0.1,nodelay=on -device virtconsole,chardev=virtcon"
# u-boot support
QB_DEFAULT_BIOS = "u-boot.bin"
QB_ROOTFS_OPT = "-drive id=disk0,file=@ROOTFS@,if=none,format=qcow2 -device virtio-blk-device,drive=disk0"
QB_OPT_APPEND += " -drive if=pflash,format=raw,index=1,file=${TMPDIR}/deploy/images/${MACHINE}/bootenv.img"
```

## src/meta-testing/conf/layer.conf
```bitbake
BBPATH .= ":${LAYERDIR}"
BBFILES += "${LAYERDIR}/recipes-*/*/*.bb \
            ${LAYERDIR}/recipes-*/*/*.bbappend"

BBFILE_COLLECTIONS += "meta-testing"
BBFILE_PATTERN_meta-testing = "^${LAYERDIR}/"
BBFILE_PRIORITY_meta-testing = "6"

LAYERDEPENDS_meta-testing = "core"
LAYERSERIES_COMPAT_meta-testing = "styhead scarthgap"
```
