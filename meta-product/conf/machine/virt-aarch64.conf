## meta-product/conf/machine/virt-aarch64.conf
```bitbake
# Custom virtual (QEMU) machine aiming for a close match of the target hardware
# 
# Heavily based on poky's qemuarm64 machine but with adjustments for 
# - runqemu configuration support
require conf/machine/include/arm/armv8a/tune-cortexa72.inc
require conf/machine/include/qemu.inc

# General
# ----
MACHINEOVERRIDES =. "qemuarm64:"

KERNEL_IMAGETYPE = "Image"
KMACHINE:virt-aarch64 = "qemuarm64"
UBOOT_MACHINE = "qemu_arm64_defconfig"

SERIAL_CONSOLES = "115200;ttyAMA0 115200;hvc0"

FIRMWARE_BINARY ??= "flash.bin"
EFI_SYSTEM_PARTITION_IMAGE ??= "efi-system-partition-image-${MACHINE}.wic.qcow2"

# Bootloader (BL33)
PREFERRED_PROVIDER_virtual/bootloader = "u-boot"

# UEFI-based (secure) boot
# efi - feature defined and used across poky, e.g. mentioned in uki.bbclass.
# uefi-secureboot - feature provided by meta-arm layers, pulls in secure-boot related configurations.
MACHINE_FEATURES:append = " efi uefi-secureboot"

# QEMU config
# ----
QB_SYSTEM_NAME = "qemu-system-aarch64"
QB_MACHINE = "-machine virt,secure=on"
QB_CPU_VALUE = "cortex-a72"
QB_CPU = "-cpu ${QB_CPU_VALUE}"
QB_MEM_VALUE = "4G"
QB_MEM = "-m ${QB_MEM_VALUE}"
QB_SMP = "-smp 4"
QB_CPU_KVM = "-cpu host -machine gic-version=3"
QB_TAP_OPT = "-netdev tap,id=net0,ifname=@TAP@,script=no,downscript=no"
QB_NETWORK_DEVICE = "-device virtio-net-pci,netdev=net0,mac=@MAC@"
QB_SERIAL_OPT = "-device virtio-serial-pci -chardev null,id=virtcon -device virtconsole,chardev=virtcon"
QB_TCPSERIAL_OPT = "-device virtio-serial-pci -chardev socket,id=virtcon,port=@PORT@,host=127.0.0.1,nodelay=on -device virtconsole,chardev=virtcon"
QB_ROOTFS_OPT = "-drive id=disk0,file=@ROOTFS@,if=none,format=qcow2 -device virtio-blk-device,drive=disk0"
# pseudo-secure boot
QB_KERNEL_ROOT = ""
QB_DEFAULT_KERNEL = "none"
QB_DEFAULT_BIOS = "${FIRMWARE_BINARY}"
QB_UEFI_OPTS = "-drive id=disk1,file=${DEPLOY_DIR_IMAGE}/${EFI_SYSTEM_PARTITION_IMAGE},if=none,format=qcow2 -device virtio-blk-device,drive=disk1"
# canbus support - see https://www.qemu.org/docs/master/system/devices/can.html
QB_EXTRA_OPTS = " \
    -object can-bus,id=canbus0 \
    -device kvaser_pci,canbus=canbus0 \
"
QB_OPT_APPEND:append = " ${QB_UEFI_OPTS} ${QB_EXTRA_OPTS}"
```

## meta-product/wic/secure-system-image.wks
```
# TODO

bootloader --ptable gpt

part --ondisk vda --source bootimg-efi --sourceparams="loader=systemd-boot,install-kernel-into-boot-dir=false" --fstype=vfat --active
```
